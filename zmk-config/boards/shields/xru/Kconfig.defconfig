## zmk-config/boards/shields/xru/Kconfig.defconfig
```kconfig
if SHIELD_XRU_LEFT

config ZMK_KEYBOARD_NAME
    default "Xru0.2"

config ZMK_SPLIT_ROLE_CENTRAL
    default y

endif

if SHIELD_XRU_LEFT || SHIELD_XRU_RIGHT

config ZMK_SPLIT
    default y

config USB_NRFX
    default y

endif

config BT_CTLR
    default BT

config ZMK_POINTING
    default y

if USB

config USB_DEVICE_STACK
    default y

endif

CONFIG_SOC_SERIES_NRF52X=y
CONFIG_SOC_NRF52840_QIAA=y

CONFIG_ZMK_SPLIT=y
CONFIG_ZMK_BLE=y
CONFIG_ZMK_SPLIT_BLE=y

CONFIG_ZMK_USB=y
CONFIG_USB_DEVICE_STACK=y

CONFIG_ZMK_POINTING=y

CONFIG_ZMK_SPLIT_BLE_CENTRAL_BATTERY_LEVEL_FETCHING=y
CONFIG_ZMK_SPLIT_BLE_CENTRAL_BATTERY_LEVEL_PROXY=y

CONFIG_ZMK_SLEEP=y
CONFIG_ZMK_IDLE_SLEEP_TIMEOUT=1800000
CONFIG_ZMK_IDLE_TIMEOUT=60000

CONFIG_ZMK_KSCAN_DEBOUNCE_PRESS_MS=5
CONFIG_ZMK_KSCAN_DEBOUNCE_RELEASE_MS=5

# Enable MPU
CONFIG_ARM_MPU=y

# enable pinctrl
CONFIG_PINCTRL=y

# enable GPIO
CONFIG_GPIO=y

# Enable writing to flash
CONFIG_USE_DT_CODE_PARTITION=y
CONFIG_BUILD_OUTPUT_UF2=y
CONFIG_MPU_ALLOW_FLASH_WRITE=y
CONFIG_NVS=y
CONFIG_SETTINGS_NVS=y
CONFIG_FLASH=y
CONFIG_FLASH_PAGE_LAYOUT=y
CONFIG_FLASH_MAP=y

# Enable 32kHz crystal
CONFIG_CLOCK_CONTROL_NRF_K32SRC_XTAL=y
CONFIG_CLOCK_CONTROL_NRF_K32SRC_30PPM=y
```

## zmk-config/boards/shields/xru/Kconfig.shield
```kconfig
config SHIELD_XRU_LEFT
    def_bool $(shields_list_contains,xru_left)

config SHIELD_XRU_RIGHT
    def_bool $(shields_list_contains,xru_right)
```
